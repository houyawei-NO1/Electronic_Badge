## main/Kconfig.projbuild
```kconfig
# =============================================================================
# ESP-IDF Project Configuration (Kconfig.projbuild)
# =============================================================================

menu "Electronic Badge Configuration"

    config APP_PROJECT_NAME
        string "Application Project Name"
        default "electronic_badge"
        help
            The name of the application firmware.

    menu "WiFi Configuration"
        config WIFI_SSID
            string "Default WiFi SSID"
            default ""
            help
                Default WiFi SSID to connect to.
                Leave empty to use saved configurations.

        config WIFI_PASSWORD
            string "Default WiFi Password"
            default ""
            help
                Default WiFi password.
                Leave empty to use saved configurations.

        config MAX_WIFI_CONFIGS
            int "Maximum saved WiFi configurations"
            range 1 10
            default 5
            help
                Maximum number of WiFi configurations to store in NVS.
    endmenu

    menu "Weather API Configuration"
        config WEATHER_API_HOST
            string "Qweather API Host"
            default "devapi.qweather.com"
            help
                API Host for Qweather (和风天气).
                Get your API Host from https://dev.qweather.com/ console.
                Format: xxx.qweatherapi.com

        config WEATHER_API_KEY
            string "Qweather API Key"
            default ""
            help
                API key for Qweather (和风天气).
                Get one from https://dev.qweather.com/

        config WEATHER_LOCATION
            string "Location Code"
            default "101180714"
            help
                Location code for weather API.
                Default is NanYangWoLong (101180714).
                Find your city code at https://dev.qweather.com/

        config UPDATE_INTERVAL_MINUTES
            int "Weather update interval (minutes)"
            range 5 1440
            default 30
            help
                How often to update weather data (in minutes).
                Default is 30 minutes.
    endmenu

    menu "Weather Icons"
        config WEATHER_ICON_ENABLED
            bool "Enable weather icon display"
            default y
            help
                Display weather icons from local resources.

        config WEATHER_ICON_SIZE
            int "Weather icon size (px)"
            range 32 128
            default 52
            help
                Size of weather icons on display.
    endmenu

    menu "Display Configuration"
        config DISPLAY_TIMEOUT_SECONDS
            int "Display auto-off timeout (seconds)"
            range 10 300
            default 60
            help
                How long to keep display on before entering sleep.

        config SPI_CLOCK_MHZ
            int "SPI clock speed (MHz)"
            range 1 80
            default 20
            help
                SPI clock speed for display communication.
                Recommended: 20MHz for stable operation with manual CS control.
    endmenu



    menu "Debug Configuration"
        config DEBUG_MODE
            bool "Enable debug mode"
            default n
            help
                Enable debug logging for GPIO states.
                When enabled, prints IO3/IO4 status changes.
                Disable for power saving in production.

        config DEBUG_LOG_LEVEL
            int "Debug log level"
            range 1 5
            default 3
            help
                Debug log verbosity level:
                1 = Error, 2 = Warn, 3 = Info, 4 = Debug, 5 = Verbose
    endmenu

endmenu
```

## sdkconfig.defaults
```kconfig
# ESP-IDF default configuration for Electronic Badge
# 注意：仅在此文件中放置需要覆盖默认值的配置项。
# 其他未列出的选项使用 ESP-IDF 默认值，无需手动指定。
# -----------------------------------------------

# Target chip
CONFIG_IDF_TARGET="esp32c3"
CONFIG_IDF_TARGET_ESP32C3=y

# Partition table
CONFIG_PARTITION_TABLE_CUSTOM=y
CONFIG_PARTITION_TABLE_CUSTOM_FILENAME="partitions.csv"
CONFIG_PARTITION_TABLE_FILENAME="partitions.csv"

# Serial flasher config
CONFIG_ESPTOOLPY_FLASHSIZE_4MB=y
CONFIG_ESPTOOLPY_FLASHSIZE="4MB"

# FreeRTOS
CONFIG_FREERTOS_HZ=1000
CONFIG_FREERTOS_UNICORE=y
CONFIG_FREERTOS_TASK_FUNCTION_WRAPPER=y
CONFIG_FREERTOS_CHECK_STACKOVERFLOW_CANARY=y
CONFIG_FREERTOS_THREAD_LOCAL_STORAGE_POINTERS=1

# WiFi
CONFIG_ESP32_WIFI_STATIC_RX_BUFFER_NUM=4
CONFIG_ESP32_WIFI_DYNAMIC_RX_BUFFER_NUM=8
CONFIG_ESP32_WIFI_DYNAMIC_TX_BUFFER_NUM=8
CONFIG_ESP_WIFI_DYNAMIC_TX_BUFFER_NUM=8

# LWIP
CONFIG_LWIP_MAX_SOCKETS=5
CONFIG_LWIP_SO_REUSE=y
CONFIG_LWIP_SO_RCVBUF=y
CONFIG_LWIP_TCPIP_RECVMBOX_SIZE=8
CONFIG_LWIP_TCP_RECVMBOX_SIZE=6
CONFIG_LWIP_UDP_RECVMBOX_SIZE=6

# SPIFFS
CONFIG_SPIFFS_MAX_PARTITIONS=1
CONFIG_SPIFFS_CACHE=y
CONFIG_SPIFFS_PAGE_CHECK=y
CONFIG_SPIFFS_GC_MAX_RUNS=3
CONFIG_SPIFFS_OBJ_NAME_LEN=32

# ESP HTTP Client
CONFIG_ESP_HTTP_CLIENT_ENABLE_HTTPS=y
CONFIG_ESP_HTTP_CLIENT_ENABLE_BASIC_AUTH=n

# System
CONFIG_ESP_TASK_WDT=y
CONFIG_ESP_TASK_WDT_TIMEOUT_S=10
CONFIG_ESP_SYSTEM_EVENT_QUEUE_SIZE=16
CONFIG_ESP_SYSTEM_EVENT_TASK_STACK_SIZE=4096
CONFIG_ESP_MAIN_TASK_STACK_SIZE=8192

# Power management
CONFIG_PM_ENABLE=y
CONFIG_FREERTOS_USE_TICKLESS_IDLE=y
CONFIG_ESP_SLEEP_POWER_DOWN_FLASH=y
CONFIG_ESP_SLEEP_FLASH_LEAKAGE_WORKAROUND=y

# Compiler options (使用 IDF v5.x 新符号, 避免 "option is obsolete" 警告)
CONFIG_COMPILER_OPTIMIZATION_DEBUG=y
CONFIG_COMPILER_OPTIMIZATION_ASSERTIONS_ENABLE=y

# Debug mode (default disabled for power saving)
CONFIG_DEBUG_MODE=n
CONFIG_DEBUG_LOG_LEVEL=3
```
